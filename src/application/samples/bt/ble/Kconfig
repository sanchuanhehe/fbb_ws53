## src/application/samples/bt/ble/Kconfig
```kconfig
#===============================================================================
# @brief    Kconfig file.
# Copyright (c) HiSilicon (Shanghai) Technologies Co., Ltd. 2023-2023. All rights reserved.
#===============================================================================

choice
    prompt "BLE Sample"

config SAMPLE_SUPPORT_BLE_SPEED_SERVER_SAMPLE
    bool "Support BLE Throughput Server Sample."

if SAMPLE_SUPPORT_BLE_SPEED_SERVER_SAMPLE
osource "application/samples/bt/ble/ble_speed_server/Kconfig"
endif

config SAMPLE_SUPPORT_BLE_HELLO_SERVER_SAMPLE
    bool "Support BLE Hello Server Sample."

config SAMPLE_SUPPORT_BLE_UART_BRIDGE_SERVER_SAMPLE
    bool "Support BLE UART Bridge Server Sample."
    select UART_SUPPORT_LPM

config SAMPLE_SUPPORT_BLE_SENSOR_REPORT_SERVER_SAMPLE
    bool "Support BLE Sensor Report Server Sample."

config SAMPLE_SUPPORT_BLE_GATEWAY_SERVER_SAMPLE
    bool "Support BLE Gateway Sensor Node Sample."

config SAMPLE_SUPPORT_BLE_HID_BTN_SAMPLE
    bool "Support BLE HID Button Sample."

if SAMPLE_SUPPORT_BLE_HID_BTN_SAMPLE
osource "application/samples/bt/ble/ble_hid_btn/Kconfig"
endif

config SAMPLE_SUPPORT_BLE_CFG_SAMPLE
    bool "Support BLE WIFI CFG Sample"

endchoice
```

## src/application/samples/bt/ble/ble_speed_server/Kconfig
```kconfig
#===============================================================================
# @brief    BLE speed server configuration.
# Copyright (c) HiSilicon (Shanghai) Technologies Co., Ltd. 2023-2026.
#===============================================================================

config BLE_SPEED_TEST
    bool
    prompt "Set the sample support speed test"
    depends on SAMPLE_SUPPORT_BLE_SPEED_SERVER_SAMPLE
    default y
    help
        Enable continuous notification throughput mode. Disable it to use
        write-and-indicate loopback mode.
```
